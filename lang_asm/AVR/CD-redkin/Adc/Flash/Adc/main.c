//-------------------------------------------------------------------------
// Основная программа обслуживания АЦП
//-------------------------------------------------------------------------

#include "Board.h"
#include "adc.h"

//флаги нажатия кнопок
volatile extern U8 flagn_kn1, flagn_kn2, flagn_kn3, flagn_kn4;

static U8 led1_old_state=0;  // переменная состояния светодиода

U8   LOWRES10 = 0;    // 10-разрядный формат результата АЦП
U8   LOWRES8  = 1;    // 8-разрядный формат результата АЦП

//начало основной программы
void main(void)
{
  CPUinit();         //инициализация системы
  timer_init();      //инициализация таймеров-счетчиков
  ADC_init (LOWRES8);  // инициализация ADC для 8-разрядного результата
  LCDinit_clear();   //нач инициализация и сброс ЖКИ

  // Вывод на ЖКИ начальной заставки
  lcd_pro_data('A', 0);
  lcd_tek_data('D');
  lcd_tek_data('C');
  lcd_tek_data('_');
  lcd_tek_data('F');
  lcd_tek_data('L');
  lcd_tek_data('A');
  lcd_tek_data('S');
  lcd_tek_data('H');


    //начало основного цикла
    for (;;)
    {
      delay(500000);  //задержка
      if  (flagn_kn1==1)    // нажималась ли кнопка 1
     	    {
            flagn_kn1=0;    //да, сбросить флаг нажатия

            //смена состояния выхода светодиода LED1 и смена инициализации АЦП
            if (led1_old_state==OFF)
                     {
                     AT91F_PIO_ClearOutput( AT91C_BASE_PIOA, LED1); // зажечь сетодиод 1
                     led1_old_state=ON;
                     lcd_clear();  //очистка экрана ЖКИ
                     ADC_init (LOWRES10);  // инициализация ADC для 10-разрядного результата
                     }
            else
                     {
                     AT91F_PIO_SetOutput( AT91C_BASE_PIOA, LED1); // погасить светодиод 1
                     led1_old_state=OFF;
                     lcd_clear();  //очистка экрана ЖКИ
                     ADC_init (LOWRES8);  // инициализация ADC для 8-разрядного результата
                     }
            }

      //циклические преобразования с выбранной разрядностью результата
      if (led1_old_state==ON)
               {
               ADC_start_ind_10(); //запуск, получение результата ADC и его индикация
                                         //для 10-разрядного результата
               }
            else
               {
               ADC_start_ind_8(); //запуск, получение результата ADC и его индикация
                                         //для 8-разрядного результата
               }

     if  (flagn_kn2==1)    // нажималась ли кнопка 2
	    {
	    flagn_kn2=0;    //да, сбросить флаг нажатия
            }

      if  (flagn_kn3==1)    // нажималась ли кнопка 3
	    {
	    flagn_kn3=0;    //да, сбросить флаг нажатия
            }

     if  (flagn_kn4==1)    // нажималась ли кнопка 4
	    {
	    flagn_kn4=0;    //да, сбросить флаг нажатия
            }
    }
}




